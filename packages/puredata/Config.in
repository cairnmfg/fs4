## packages/puredata/Config.in
```kconfig
config BR2_PACKAGE_PUREDATA
    bool "puredata"
    select BR2_PACKAGE_ALSA_LIB
    select BR2_PACKAGE_ALSA_UTILS
    select BR2_PACKAGE_GETTEXT
    select BR2_PACKAGE_TCL
     help
        graphic realtime audio programming language
```
